## net/Kconfig
```kconfig
#
# Network configuration
#

menuconfig NET
	bool "Networking support"
	default y

if NET

config NET_RANDOM_ETHADDR
	bool "Random ethaddr if unset"
	help
	  Selecting this will allow the Ethernet interface to function
	  even when the ethaddr variable for that interface is unset.
	  A new MAC address will be generated on every boot and it will
	  not be added to the environment.

config NETCONSOLE
	bool "NetConsole support"
	help
	  Support the 'nc' input/output device for networked console.
	  See README.NetConsole for details.

config TCP
	bool "Enable Mediatek TCP framework"
	default n
	help
	  Enable Mediatek TCP framework that allows some customized features.

config HTTPD
	bool "Enable Mediatek HTTPD framework"
	default n
	depends on TCP
	help
	  Enable Mediatek HTTPD framework that allows some customized features.

config MTK_DHCPD
	bool "Minimal DHCP server for MediaTek web failsafe"
	default y
	depends on HTTPD
	help
	  Enable a minimal DHCPv4 server that answers DHCPDISCOVER/DHCPREQUEST
	  while the MediaTek web failsafe UI (httpd) is running.
	  Default configuration:
	    - Server IP: 192.168.1.1
	    - Netmask: 255.255.255.0
	    - DHCP pool: 192.168.1.100 ~ 192.168.1.200

endif   # if NET
```

## oraybox/mt7620/boards/R300A_1121G/mt7620_oraybox_r300a_1121g_defconfig
```kconfig
CONFIG_MIPS=y
CONFIG_SKIP_LOWLEVEL_INIT=y
CONFIG_SYS_MALLOC_LEN=0x100000
CONFIG_SPL_LIBCOMMON_SUPPORT=y
CONFIG_SPL_LIBGENERIC_SUPPORT=y
CONFIG_NR_DRAM_BANKS=1
CONFIG_ENV_SIZE=0x1000
# CONFIG_ENV_OFFSET 默认 0x30000，与蒲公英的 kpanic/u-boot-env 区一致
CONFIG_ENV_OFFSET=0x30000
CONFIG_ENV_SECT_SIZE=0x10000
CONFIG_DEFAULT_DEVICE_TREE="mt7620-oraybox-r300a-1121g"
CONFIG_SPL_SYS_MALLOC_F_LEN=0x40000
CONFIG_SPL_SERIAL=y
CONFIG_SPL_BSS_START_ADDR=0x80010000
CONFIG_SPL_BSS_MAX_SIZE=0x10000
CONFIG_SYS_BOOTM_LEN=0x1000000
CONFIG_SYS_LOAD_ADDR=0x80010000
CONFIG_SPL=y
CONFIG_DEBUG_UART_BASE=0xb0000c00
CONFIG_DEBUG_UART_CLOCK=40000000
CONFIG_ARCH_MTMIPS=y
CONFIG_SYS_MIPS_TIMER_FREQ=290000000
CONFIG_MIPS_CACHE_SETUP=y
CONFIG_MIPS_CACHE_DISABLE=y
CONFIG_RESTORE_EXCEPTION_VECTOR_BASE=y
CONFIG_MIPS_BOOT_FDT=y
CONFIG_DEBUG_UART=y
CONFIG_FIT=y
# CONFIG_ARCH_FIXUP_FDT_MEMORY is not set
CONFIG_SYS_MALLOC_BOOTPARAMS=y
CONFIG_SPL_MAX_SIZE=0x10000
CONFIG_SPL_SYS_MALLOC_SIMPLE=y
CONFIG_SPL_NOR_SUPPORT=y
# CONFIG_CMD_ELF is not set
# CONFIG_CMD_XIMG is not set
# CONFIG_CMD_CRC32 is not set
# CONFIG_CMD_DM is not set
CONFIG_CMD_GPIO=y
# CONFIG_CMD_LOADS is not set
CONFIG_CMD_MMC=y
CONFIG_CMD_SPI=y
CONFIG_CMD_USB=y
CONFIG_CMD_MII=y
# CONFIG_CMD_MDIO is not set
CONFIG_CMD_FAT=y
CONFIG_CMD_FS_GENERIC=y
# CONFIG_SPL_DOS_PARTITION is not set
# CONFIG_ISO_PARTITION is not set
CONFIG_EFI_PARTITION=y
# CONFIG_SPL_EFI_PARTITION is not set
CONFIG_OF_SPL_REMOVE_PROPS="pinctrl-0 pinctrl-names clocks clock-names interrupt-parent interrupts resets reset-names"
CONFIG_ENV_IS_IN_SPI_FLASH=y
CONFIG_ENV_RELOC_GD_ENV_ADDR=y
CONFIG_NET_RANDOM_ETHADDR=y
CONFIG_SPL_DM=y
# CONFIG_SIMPLE_BUS is not set
# CONFIG_SPL_SIMPLE_BUS is not set
CONFIG_GPIO_HOG=y
# CONFIG_INPUT is not set
CONFIG_MMC=y
# CONFIG_MMC_QUIRKS is not set
# CONFIG_MMC_HW_PARTITIONING is not set
CONFIG_MMC_MTK=y
CONFIG_SPI_FLASH_SFDP_SUPPORT=y
CONFIG_SPI_FLASH_EON=y
CONFIG_SPI_FLASH_GIGADEVICE=y
CONFIG_SPI_FLASH_ISSI=y
CONFIG_SPI_FLASH_MACRONIX=y
CONFIG_SPI_FLASH_SPANSION=y
CONFIG_SPI_FLASH_STMICRO=y
CONFIG_SPI_FLASH_WINBOND=y
CONFIG_SPI_FLASH_XMC=y
CONFIG_MT7620_ETH=y
CONFIG_PHY=y
CONFIG_MT7620_USB_PHY=y
CONFIG_SPECIFY_CONSOLE_INDEX=y
CONFIG_DEBUG_UART_SHIFT=2
CONFIG_SPI=y
CONFIG_MT7620_SPI=y
CONFIG_USB=y
CONFIG_USB_EHCI_HCD=y
CONFIG_USB_EHCI_GENERIC=y
CONFIG_LZMA=y
CONFIG_SPL_LZMA=y

# --- OrayBox R300A（MT7620+MT7530 千兆）追加，符号均对 v2026.07 校验过 ---
CONFIG_CMD_BOOTMENU=y
CONFIG_CMD_SF=y
CONFIG_CMD_MTD=y
CONFIG_CMD_MTDPARTS=y
CONFIG_CMD_DHCP=y
CONFIG_CMD_TFTPBOOT=y
CONFIG_CMD_PING=y
CONFIG_LZMA=y
# mainline 的 dm-spi 没有 XIP 窗口，先 sf read 再 bootm
CONFIG_USE_BOOTCOMMAND=y
CONFIG_BOOTCOMMAND="sf probe 0 50000000; sf read 0x83000000 0x50000 0x400000; bootm 0x83000000"

# --- 瘦身：这些芯片/接口板子上没有，或原厂内核用不到（MT7620 的 rfb 默认全开，会撑爆 192K u-boot 分区）---
# CONFIG_MMC is not set
# CONFIG_CMD_MMC is not set
# CONFIG_DM_MMC is not set
# CONFIG_USB is not set
# CONFIG_USB_EHCI_HCD is not set
# CONFIG_CMD_USB is not set
# CONFIG_USB_STORAGE is not set
# CONFIG_DOS_PARTITION is not set
# CONFIG_CMD_FS_GENERIC is not set
# CONFIG_FIT is not set
# CONFIG_SPL_LOAD_FIT is not set
```

## oraybox/mt7628/boards/X1_1111/mt7628_oraybox_x1_1111_defconfig
```kconfig
CONFIG_MIPS=y
CONFIG_SKIP_LOWLEVEL_INIT=y
CONFIG_SYS_MALLOC_LEN=0x100000
CONFIG_SPL_LIBCOMMON_SUPPORT=y
CONFIG_SPL_LIBGENERIC_SUPPORT=y
CONFIG_NR_DRAM_BANKS=1
CONFIG_ENV_SIZE=0x10000
CONFIG_ENV_OFFSET=0x30000
CONFIG_ENV_SECT_SIZE=0x10000
CONFIG_BOOTDELAY=3
CONFIG_DEFAULT_DEVICE_TREE="mt7628a-oraybox-x1-1111"
CONFIG_SPL_SYS_MALLOC_F_LEN=0x40000
CONFIG_SPL_SERIAL=y
CONFIG_SPL_BSS_START_ADDR=0x80010000
CONFIG_SPL_BSS_MAX_SIZE=0x10000
CONFIG_SYS_BOOTM_LEN=0x1000000
CONFIG_SYS_LOAD_ADDR=0x80010000
CONFIG_SPL=y
CONFIG_ARCH_MTMIPS=y
CONFIG_SOC_MT7628=y
CONFIG_BOARD_MT7628_RFB=y
CONFIG_SYS_MIPS_TIMER_FREQ=290000000
CONFIG_MIPS_CACHE_SETUP=y
CONFIG_MIPS_CACHE_DISABLE=y
CONFIG_RESTORE_EXCEPTION_VECTOR_BASE=y
CONFIG_MIPS_BOOT_FDT=y
CONFIG_FIT=y
# CONFIG_ARCH_FIXUP_FDT_MEMORY is not set
CONFIG_SYS_CONSOLE_INFO_QUIET=y
CONFIG_SYS_MALLOC_BOOTPARAMS=y
CONFIG_SPL_MAX_SIZE=0x10000
CONFIG_SPL_SYS_MALLOC_SIMPLE=y
CONFIG_SPL_NOR_SUPPORT=y
# CONFIG_CMD_ELF is not set
# CONFIG_CMD_XIMG is not set
# CONFIG_CMD_CRC32 is not set
# CONFIG_CMD_DM is not set
CONFIG_CMD_GPIO=y
# CONFIG_CMD_LOADS is not set
CONFIG_CMD_SPI=y
CONFIG_ENV_IS_IN_SPI_FLASH=y
CONFIG_ENV_RELOC_GD_ENV_ADDR=y   # v2026.01 起才有；用 v2024.07 编请删掉这行
CONFIG_NET_RANDOM_ETHADDR=y
# CONFIG_INPUT is not set
CONFIG_SPI_FLASH_EON=y
CONFIG_SPI_FLASH_GIGADEVICE=y
CONFIG_SPI_FLASH_ISSI=y
CONFIG_SPI_FLASH_MACRONIX=y
CONFIG_SPI_FLASH_SPANSION=y
CONFIG_SPI_FLASH_STMICRO=y
CONFIG_SPI_FLASH_WINBOND=y
CONFIG_SPI_FLASH_XMC=y
CONFIG_MT7628_ETH=y
CONFIG_SPI=y
CONFIG_MT7621_SPI=y
CONFIG_LZMA=y
CONFIG_SPL_LZMA=y

# --- OrayBox X4C 追加项（符号均在 v2024.07 树里校验过：oraybox/tools/check-config.sh）---
# 恢复路径：mainline 没有原厂 1.1.3 的 failsafe httpd，改用 bootmenu + TFTP/DHCP
CONFIG_CMD_BOOTMENU=y
CONFIG_CMD_SF=y
CONFIG_CMD_MTD=y
CONFIG_CMD_MTDPARTS=y
CONFIG_CMD_DHCP=y
CONFIG_CMD_TFTPBOOT=y
CONFIG_CMD_PING=y
# 不写死 CONFIG_MTDPARTS_DEFAULT：dm-spi 下的 mtd id 要第一次开机 `mtd list` 才知道，别拿没验证的字符串硬编
# 启动：mainline 的 SPI 是 dm-spi（没有 0xBF000000 XIP），所以先 sf read 再 bootm
CONFIG_USE_BOOTCOMMAND=y
CONFIG_BOOTCOMMAND="sf probe 0 50000000; sf read 0x83000000 0x50000 0x400000; bootm 0x83000000"
# --- 体积守卫：192K 的 u-boot 分区装不下 rfb 默认全家桶，关掉板子上没有/用不到的 ---
# CONFIG_MMC is not set
# CONFIG_CMD_MMC is not set
# CONFIG_DM_MMC is not set
# CONFIG_USB is not set
# CONFIG_CMD_USB is not set
# CONFIG_USB_STORAGE is not set
# CONFIG_DOS_PARTITION is not set
# CONFIG_CMD_FS_GENERIC is not set
# env 落在 kpanic 分区 0x30000+0x10000（按本板分区表推导）
```
